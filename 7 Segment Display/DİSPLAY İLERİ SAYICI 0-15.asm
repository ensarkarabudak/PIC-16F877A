;************DÝSPLAYE ÝLERÝ 0- 15 ARASI SAYICI*****

	list p=16f877A
	#include <p16f877A.inc>
	VERI EQU 0X20
	SAYAC0 EQU 0X21
    SAYAC1 EQU 0X22
	SAYAC2 EQU 0X23
    BANKSEL TRISA
	CLRF TRISA
    CLRF TRISD
    BANKSEL PORTA
    CLRF PORTA
    BSF PORTA,0
BASADON    
	CLRF	PORTD
	CLRF VERI
BASLA
	MOVF VERI,W
	ANDLW	.15
	CALL CEVRIM
	MOVWF PORTD
	MOVLW .250
	CALL GECIK
	INCFSZ VERI,1
	GOTO BASLA
	GOTO BASADON
CEVRIM
ADDWF PCL,F
RETLW H'3F' 
RETLW H'06' 
RETLW H'5B' 
RETLW H'4F' 
RETLW H'66' 
RETLW H'6D' 
RETLW H'7D' 
RETLW H'07' 
RETLW H'7F' 
RETLW H'6F' 
RETLW H'77'
RETLW H'7C' 
RETLW H'39' 
RETLW H'5E'
RETLW H'79'
RETLW H'71'
GECIK				;working register'a atýlan deger kadar ms gecik
	MOVWF SAYAC0		;( W * 8 * 255 ) / 2 = W * 1020µsec ~= W ms @ 8Mmhz
DONGU0
	MOVLW D'8'
	MOVWF SAYAC1
DONGU1
	CLRF SAYAC2
DONGU2
	INCFSZ SAYAC2,F
	GOTO DONGU2
	DECFSZ SAYAC1,F
	GOTO DONGU1
	DECFSZ SAYAC0,F
	GOTO DONGU0
	RETURN   


 
END

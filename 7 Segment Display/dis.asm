    	LIST    p=16F877
		#include "P16F877.INC"
		BSF STATUS,RP0 ;BANK1'E GEÇ 
 		BCF STATUS,RP1
		MOVLW h'00'
		MOVWF TRISA ; TRISA'YI DÝSPLAYLARI SEÇMEK ÝÇÝN ÇIKIÞ YAPTIK
		MOVWF TRISD ;TRÝSD'YÝ ÇIKIÞ YAP
		BCF STATUS,5 ; BANK0'A GEÇ
		MOVLW H'01'		; SADECE SONDAKÝ DÝSPLAY ÝN YANMASI
		MOVWF PORTA 	; ÝÇÝN B'00000001' SAYISINI PORTA YA VERDÝK
		 
	
		SAYAC EQU 20H ; SAYAÇLARI TANIMLA
		SAYAC2 EQU 21H ;
		SAYAC3 EQU 22H ;
		
		SIFIR EQU 23H ; YAZDIRILACAK SAYIYI OLUÞTURAN BÝNARY 
		BIR EQU 24H   ; SAYIYI OLUÞTURMA
		IKI EQU 25H
		UC EQU 26H
		DORT EQU 27H
		BES EQU 28H
		ALTI EQU 29H
		YEDI EQU 2AH
		SEKIZ EQU 2BH
		DOKUZ EQU 2CH
		AA EQU 2DH
		BB EQU 2EH
		CC EQU 2FH
		DD EQU 30H
		EE EQU 31H
		FF EQU 32H


		SAY1 EQU 33H ; OLUÞTURDUÐUMUZ SAYILARDAN BÝZE LAZIM 
		SAY2 EQU 34H  ; OLANI SEÇERKEN KULLANACAÐIMIZ SAYAÇLAR
		SAY3 EQU 35H
		SAY4 EQU 36H
		SAY5 EQU 37H
		SAY6 EQU 38H
		SAY7 EQU 39H
		SAY8 EQU 3AH
		SAY9 EQU 3BH
		SAYAA EQU 3CH
		SAYBB EQU 3DH
		SAYCC EQU 3EH
		SAYDD EQU 3FH
		SAYEE EQU 40H
		SAYFF EQU 41H
		SAY0 EQU 42H
	
		MOVLW H'01'  ; SAYAÇLARIN HEPSÝNÝ 01 YAPIYORUZ
		MOVWF SAY0
		MOVWF SAY1
		MOVWF SAY2
		MOVWF SAY3
		MOVWF SAY4
		MOVWF SAY5
		MOVWF SAY6
		MOVWF SAY7
		MOVWF SAY8
		MOVWF SAY9
		MOVWF SAYAA
		MOVWF SAYBB
		MOVWF SAYCC
		MOVWF SAYDD
		MOVWF SAYEE
		MOVWF SAYFF
	
	
		MOVLW B'00111111'   ; DÝSPLAY'DE YANACAK OLAN SEGMENTLERÝN 
		MOVWF SIFIR			; BELÝRLENDÝÐÝ YER (SAYI OLUÞTURMA)
		MOVLW B'00000110'
		MOVWF BIR
		MOVLW B'01011011'
		MOVWF IKI
		MOVLW B'01001111'
		MOVWF UC
		MOVLW B'01100110'
		MOVWF DORT
		MOVLW B'01101101'
		MOVWF BES
		MOVLW B'01111101' 
		MOVWF ALTI
		MOVLW B'00000111'
		MOVWF YEDI
		MOVLW B'01111111'
		MOVWF SEKIZ
		MOVLW B'01101111'
		MOVWF DOKUZ
		MOVLW B'01110111'
		MOVWF AA
		MOVLW B'01111100'
		MOVWF BB
		MOVLW B'00111001'
		MOVWF CC
		MOVLW B'01011110'
		MOVWF DD
		MOVLW B'01111001'
		MOVWF EE
		MOVLW B'01110001'
		MOVWF FF

	
	ÜST:CALL SAYIBUL ;SAYI BULMAK ÝÇÝN ALTPROGRAMI ÇAÐIR
		MOVWF PORTD  ; DÖNEN SAYIYI PORTD YE YAZALIM
		MOVLW H'FF'  ; BURADA DÖNGÜLERLE PROGRAMI UYUTUYORUZ
		MOVWF SAYAC
	ÜST2:MOVLW H'FF'
		MOVWF SAYAC2
	ÜST3:MOVLW H'08'
		MOVWF SAYAC3
	ALT3:DECFSZ SAYAC3,1
		GOTO ALT3
	ALT2:DECFSZ SAYAC2,1
		GOTO ÜST3
	ALT:DECFSZ SAYAC,1
		GOTO ÜST2	
		GOTO ÜST
	

		SAYIBUL:
		DECFSZ SAY0,1
		GOTO A1
		MOVLW H'00'
		ADDWF SIFIR,0
		RETURN
	A1:DECFSZ SAY1,1
		GOTO A2
		MOVLW h'00'
			ADDWF BIR,0
		RETURN
	A2:DECFSZ SAY2,1
		GOTO A3
		MOVLW h'00'
		ADDWF IKI,0
		RETURN
	A3:DECFSZ SAY3,1
		GOTO A4
		MOVLW H'00'
		ADDWF UC,0
		RETURN
	A4:DECFSZ SAY4,1
		GOTO A5
		MOVLW H'00'
		ADDWF DORT,0
		RETURN	
	A5:DECFSZ SAY5,1
		GOTO A6
		MOVLW H'00'
		ADDWF BES,0
		RETURN
	A6:DECFSZ SAY6,1
		GOTO A7
		MOVLW H'00'
		ADDWF ALTI,0
		RETURN
	A7:DECFSZ SAY7,1
		GOTO A8
		MOVLW H'00'
		ADDWF YEDI,0
		RETURN
	A8:DECFSZ SAY8,1
		GOTO A9
		MOVLW H'00'
		ADDWF SEKIZ,0
		RETURN
	A9:DECFSZ SAY9,1
		GOTO A10
		MOVLW H'00'
		ADDWF DOKUZ,0
		RETURN
	A10:DECFSZ SAYAA,1
		GOTO A11
		MOVLW H'00'
		ADDWF AA,0
		RETURN
	A11:DECFSZ SAYBB,1
		GOTO A12
		MOVLW H'00'
		ADDWF BB,0
		RETURN
	A12:DECFSZ SAYCC,1
		GOTO A13
		MOVLW H'00'
		ADDWF CC,0
		RETURN
	A13:DECFSZ SAYDD,1
		GOTO A14
		MOVLW H'00'
		ADDWF DD,0
		RETURN
	A14:DECFSZ SAYEE,1
		GOTO A15
		MOVLW H'00'
		ADDWF EE,0
		RETURN
	A15:DECFSZ SAYFF,1
		NOP
    	MOVLW H'01'
		MOVWF SAY0
		MOVWF SAY1
		MOVWF SAY2
		MOVWF SAY3
		MOVWF SAY4
		MOVWF SAY5
		MOVWF SAY6
		MOVWF SAY7
		MOVWF SAY8
		MOVWF SAY9
		MOVWF SAYAA
		MOVWF SAYBB
		MOVWF SAYCC
		MOVWF SAYDD
		MOVWF SAYEE
		MOVWF SAYFF

		MOVLW H'00'
		ADDWF FF,0
		RETURN




	END
	
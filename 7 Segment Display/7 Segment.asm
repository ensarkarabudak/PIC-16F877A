LIST P=16f877A
#INCLUDE <P16F877A.INC>

SAYI1	EQU	0X21
SAYI2	EQU	0X22
SAYI3	EQU	0X23
SAYI4	EQU	0X24
BIRLER	EQU	0X25
ONLAR	EQU	0X26
YUZLER	EQU	0X27
BINLER	EQU	0X28
SAYAC	EQU	0X29
DEG1	EQU	0X30
DEG2	EQU	0X31

		ORG	0x00
		CALL	BASLA
		GOTO	LOOP
		ORG		0X04
		CALL	KESME
LOOP
	NOP
	NOP
	CALL	GOSTER
	GOTO	LOOP
	
;-------------
BASLA
	CLRF	 DEG1
	CLRF	 DEG2
	BSF		 STATUS,5
	MOVLW 	 B'11110000'
	MOVWF    TRISC
	MOVLW 	 B'10000000'	
	MOVWF	 TRISD
	BCF	 	STATUS,5
	CLRF	BIRLER
	CLRF	ONLAR
	CLRF	YUZLER
	CLRF	BINLER
	CLRF	SAYI1
	CLRF	SAYI2
	CLRF	SAYI3
	CLRF	SAYI4

;--KESME KODLARI
			MOVLW	B'11010000'
			MOVWF	INTCON
			
			BSF		STATUS,RP0

			BSF		PIR1,TMR1IF
			BSF		PIE1,TMR1IE
		
			BCF		STATUS,RP0
		
			MOVLW	B'00110001'
			MOVWF	T1CON
			
			MOVLW	0X3C
			MOVWF	TMR1H
			MOVLW	0XB0
			MOVWF	TMR1L
		
			MOVLW	D'5'
			MOVWF	SAYAC
			
			CLRF	PORTD
			CLRF	PORTC
RETURN

;-----------
KESME
			
			BCF		INTCON,GIE

			BTFSC	PIR1,TMR1IF
			CALL	TIMER_1
		
			BSF		INTCON,GIE
			RETURN
;-----------
TIMER_1
	
			DECFSZ	SAYAC,F
			GOTO	L1
			
			MOVLW	D'5'
			MOVWF	SAYAC
			GOTO	ART
L1
			BCF		PIR1,TMR1IF
			
			MOVLW	0X3C
			MOVWF	TMR1H
		
			MOVLW	0XB0
			MOVWF	TMR1L
			CALL	GOSTER
			RETURN

;-----------
ART
	INCF	BIRLER,F
	MOVLW	D'10'
	SUBWF	BIRLER,W
	BTFSS	STATUS,Z
	GOTO	GOSTER
	CLRF	BIRLER

	INCF	ONLAR,F
	MOVLW	D'6'
	SUBWF	ONLAR,W
	BTFSS	STATUS,Z
	GOTO	GOSTER
	CLRF	ONLAR

	INCF	YUZLER,F
	MOVLW	D'10'
	SUBWF	YUZLER,W
	BTFSS	STATUS,Z
	GOTO	GOSTER
	CLRF	YUZLER

	INCF	BINLER,F
	MOVLW	D'6'
	SUBWF	BINLER,W
	BTFSS	STATUS,Z
	GOTO	GOSTER
	CLRF	BINLER

GOSTER
	CLRF	PORTD
	MOVLW	B'00001110'
	MOVWF	PORTC
	MOVF    BIRLER,W
   	CALL	TABLO
	MOVWF   PORTD
	CALL	GECIKME
	CALL	GECIKME
	CLRF	PORTD

	MOVLW	B'00001101'
	MOVWF	PORTC
	MOVF    ONLAR,W
   	 CALL	TABLO
	MOVWF   PORTD
	CALL	GECIKME
	CLRF	PORTD

	MOVLW	B'00001011'
	MOVWF	PORTC
	MOVF    YUZLER,W
   		 CALL	TABLO
	MOVWF   PORTD
	CALL	GECIKME
	CLRF	PORTD

	MOVLW	B'00000111'
	MOVWF	PORTC
	MOVF    BINLER,W
  	  CALL	TABLO
	MOVWF   PORTD
	CALL	GECIKME
	CLRF	PORTD
	RETURN

GECIKME
	MOVLW	D'55'
	MOVWF	DEG1
D11	
	MOVLW	D'55'
	MOVWF	DEG2
D22
	DECFSZ	DEG2,F
	GOTO	D22
	DECFSZ	DEG1,F
	GOTO	D11
	RETURN

TABLO
	ADDWF	PCL,F
	RETLW	h'3F'
	RETLW	h'06'
	RETLW	h'5B'
	RETLW	h'4F'
	RETLW	h'66'
	RETLW	h'6D'
	RETLW	h'7D'
	RETLW	h'07'
	RETLW	h'7F'
	RETLW	h'6F'
	RETLW	h'77'
	RETLW	h'7C'
	RETLW	h'39'
	RETLW	h'5E'
	RETLW	h'79'
	RETLW	h'71'
	RETLW	h'80'

	END




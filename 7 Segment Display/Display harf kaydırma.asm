;DÝSPLAYDA L HARFÝ KAYIYOR	
    list p=16F877A
	#include <P16F877A.INC>
	SAYAC0 EQU 0x021
	SAYAC1 EQU 0x022
	SAYAC2	EQU 0x023
	BSF STATUS,5
	CLRF TRISD
	MOVLW H'F0'
	MOVWF TRISA
	BCF STATUS,5
	CLRF PORTA
	CLRF PORTD
BASLA
bsf	PORTA,0
movlw 38h
movwf PORTD
MOVLW .250
CALL GECIK

BCF	 PORTA,0
BSF	PORTA,1
MOVLW .250
CALL GECIK

BCF	PORTA,1
BSF	PORTA,2
MOVLW .250
CALL GECIK

BCF	PORTA,2
BSF	PORTA,3
MOVLW .250
CALL GECIK

BCF	PORTA,3
bsf	PORTA,2
MOVLW .250
CALL GECIK

BCF	 PORTA,2
BSF	PORTA,1
MOVLW .250
CALL GECIK

BCF PORTA,1
BCF PORTA,3

GOTO BASLA


	
GECIK				;working register'a atýlan deger kadar ms gecik
	MOVWF SAYAC0		;( W * 8 * 255 ) / 2 = W * 1020µsec ~= W ms @ 8Mmhz
DONGU0
	MOVLW D'8'
	MOVWF SAYAC1
DONGU1
	CLRF SAYAC2
DONGU2
	INCFSZ SAYAC2,F
	GOTO DONGU2
	DECFSZ SAYAC1,F
	GOTO DONGU1
	DECFSZ SAYAC0,F
	GOTO DONGU0
	RETURN
	END

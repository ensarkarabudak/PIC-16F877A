			LIST		P=16F877
			INCLUDE		"P16F877.INC"
SAYAC		EQU			20H
VERI		EQU			23H

			ORG			0X0000
BASLA
			BANKSEL		TRISD
			CLRF		TRISD
			MOVLW		0F0H
			MOVWF		TRISA
			BANKSEL		20H
			CLRF		PORTA
			CLRF		PORTD
DONGU
			BCF			PORTA,3
			BSF			PORTA,0
			MOVLW		b'01001111';3 yazar en saр
			MOVWF		PORTD
			MOVWF		PORTD
			MOVWF		PORTD
			CLRF		PORTD
			BCF			PORTA,0
			BSF			PORTA,1
			MOVLW		b'01011011';2 yazar
			MOVWF		PORTD
			MOVWF		PORTD
			MOVWF		PORTD
			CLRF		PORTD
			BCF			PORTA,1
			BSF			PORTA,2
			MOVLW		b'01001111'
			MOVWF		PORTD
			MOVWF		PORTD
			MOVWF		PORTD
			CLRF		PORTD
			BCF			PORTA,2
			BSF			PORTA,3
			MOVLW		b'01011011'		;en sol
			MOVWF		PORTD
			MOVWF		PORTD
			MOVWF		PORTD
			CLRF		PORTD
			GOTO		DONGU

			

 end 
				
;************DÝSPLAYE ÝSÝM YAZDIRMAK*****

	list p=16f877A
	#include <p16f877A.inc>
SAYAC0 EQU 0X21
SAYAC1 EQU 0X22
SAYAC2 EQU 0X23

    BANKSEL TRISD
	CLRF TRISD
	MOVLW H'F0'
    MOVWF TRISA
    BANKSEL PORTA
    CLRF PORTA
	CLRF PORTD
	MOVLW H'6D'
	MOVWF PORTD
	
BASLA
	
	BSF PORTA,0;0. DÝSP SEÇÝLÝR
	MOVLW .250
	CALL GECIK
	
	BCF PORTA,0;0. DÝSPÝ KAPAT
	BSF PORTA,1;1. DÝSPÝ AÇ
 	MOVLW .250
	CALL GECIK
	
	BCF PORTA,1;
	BSF PORTA,2
	MOVLW .250
	CALL GECIK
	
	BCF PORTA,2
	BSF PORTA,3
	MOVLW .250
	CALL GECIK

	BCF PORTA,3
	BSF PORTA,2
	MOVLW .250
	CALL GECIK
	
	BCF PORTA,2
	BSF PORTA,1
	MOVLW .250
	CALL GECIK
	
	BCF	PORTA,1
GOTO BASLA
GECIK				;working register'a atýlan deger kadar ms gecik
	MOVWF SAYAC0		;( W * 8 * 255 ) / 2 = W * 1020µsec ~= W ms @ 8Mmhz
DONGU0
	MOVLW D'8'
	MOVWF SAYAC1
DONGU1
	CLRF SAYAC2
DONGU2
	INCFSZ SAYAC2,F
	GOTO DONGU2
	DECFSZ SAYAC1,F
	GOTO DONGU1
	DECFSZ SAYAC0,F
	GOTO DONGU0
	RETURN
 
END

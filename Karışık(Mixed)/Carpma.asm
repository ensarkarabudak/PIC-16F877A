LIST P=16f877a
#INCLUDE <P16F877A.INC>
DEG2		EQU		0X25
DEG1		EQU		0X24
SAYAC1		EQU		0X21
SAYAC2		EQU		0X22
SONUC		EQU		0X23
			
			ORG     0X00
	 	        CLRF	PORTB
			CLRF	PORTC
			CLRF	PORTD
			BSF		STATUS,5
			MOVLW	H'FF'
			MOVWF	TRISB
			MOVLW	H'FF'
			MOVWF	TRISC
			CLRF	TRISD
			BCF		STATUS,5
LOOP		
			
			MOVF	PORTB,W
			MOVWF	DEG1
			MOVLW	0X0A
			MOVWF	DEG2
			MOVF	DEG2,0
			SUBWF	DEG1,0
			BTFSS	STATUS,C
			GOTO	ATA
			GOTO    LOOP
ATA
			MOVF    PORTB,W
			MOVWF	SAYAC1
LOOP2
			MOVF	PORTC,W
			MOVWF	DEG1
			MOVLW	0X0A
			MOVWF	DEG2
			MOVF	DEG2,0
			SUBWF	DEG1,0
			BTFSS	STATUS,C
			GOTO	ATA2
			GOTO    LOOP2
ATA2
			MOVF	PORTC,W
			MOVWF	SAYAC2
			CLRF	SONUC
		
DON
			MOVF	SAYAC1,W
			ADDWF	SONUC,F
			DECFSZ	SAYAC2,F
			GOTO DON
			MOVF	SONUC,W
			MOVWF	PORTD
END
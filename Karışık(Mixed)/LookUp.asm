 	list p=16F877
	include"p16F877.inc"
	
	DEGÝSKEN EQU 0X23

	SAYAC1 EQU 0X21
	SAYAC2 EQU 0X22

	ORG 0X00 

	BANKSEL TRISB	
	CLRF TRISB
	BANKSEL PORTB
	CLRF PORTB
	CLRF DEGÝSKEN

DÖN
	MOVF DEGÝSKEN,W
	CALL LOOK_UP
	MOVWF PORTB
	MOVLW h'01'
	CALL GECÝK
	INCF DEGÝSKEN,F
	GOTO DÖN

LOOK_UP
	addwf	PCL,F
	RETLW h'00'
	RETLW h'03'
	RETLW h'0C'
	RETLW h'F0'
	RETLW h'0C'
	RETLW h'03'
	RETLW h'00'
	RETLW h'F0'
	RETLW h'1E'
	RETLW h'11'
	RETLW h'11'
	RETLW h'1E'
	RETLW h'F0'
	RETLW h'00'
	RETLW h'FF'
	RETLW h'01'
	RETLW h'06'
	RETLW h'08'
	RETLW h'06'
	RETLW h'01'
	RETLW h'FF'
	RETLW h'00'
	RETLW h'F0'
	RETLW h'1E'
	RETLW h'11'
	RETLW h'11'
	RETLW h'1E'
	RETLW h'F0'
	RETLW h'00'
	RETLW h'FF'
	RETLW h'01'
	RETLW h'0E'
	RETLW h'70'
	RETLW h'80'
	RETLW h'FF'
	RETLW h'00'
	CLRF DEGÝSKEN
	MOVLW h'00'
	CALL GECÝK1

	




GECÝK

	MOVWF SAYAC1	
DÖN1
	MOVLW h'FF'
	MOVWF SAYAC2
DÖN2
	DECFSZ SAYAC2,1
	GOTO DÖN2
	DECFSZ SAYAC1,1
	GOTO DÖN1
	RETURN	

GECÝK1

	MOVWF SAYAC1	
DÖN11
	MOVLW h'FF'
	MOVWF SAYAC2
DÖN12
	DECFSZ SAYAC2,1
	GOTO DÖN12
	DECFSZ SAYAC1,1
	GOTO DÖN11
	RETURN	

END
	
	
;*******************KAYAN NOKTA******************
list p=16F877A
	#include <P16F877A.INC>
	BSF STATUS,5
	CLRF TRISC
	BCF STATUS,5
	SAYAC0 EQU 0X21
	SAYAC1 EQU 0X22
	SAYAC2 EQU 0X23
BASLA
	CLRF PORTC
	MOVLW B'00000001'
	MOVWF PORTC
	
SOL
	MOVLW .250
	CALL GECIKME
	RLF PORTC,F
	BTFSS PORTC,7
	GOTO SOL
SAG
	MOVLW .250
	CALL GECIKME
	RRF PORTC,F
	BTFSS PORTC,0
	GOTO SAG
	GOTO SOL

GECIKME				;working register'a atýlan deger kadar ms gecik
	MOVWF SAYAC0		;( W * 8 * 255 ) / 2 = W * 1020µsec ~= W ms @ 8Mmhz
DONGU0
	MOVLW D'8'
	MOVWF SAYAC1
DONGU1
	CLRF SAYAC2
DONGU2
	INCFSZ SAYAC2,F
	GOTO DONGU2
	DECFSZ SAYAC1,F
	GOTO DONGU1
	DECFSZ SAYAC0,F
	GOTO DONGU0
	RETURN	
	
END

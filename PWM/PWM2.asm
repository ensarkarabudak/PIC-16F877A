#INCLUDE <P16F877A.INC>
	SAYAC1  EQU  0X20
	SAYAC2  EQU  0X21
	SAYAC3	EQU	 0X22
	ORG	0X00

ANA_PROGRAM
  	BANKSEL TRISC
  	CLRF TRISC
  	BSF	TRISD,0
	BSF	TRISD,1

  	BANKSEL PR2
  	MOVLW D'59'
  	MOVWF PR2

  	BANKSEL T2CON
  	MOVLW B'00000100'
  	MOVWF T2CON

  	BANKSEL CCP1CON
 	MOVLW B'00101100'
  	MOVWF CCP1CON	

  	BANKSEL CCPR1L	
  	MOVLW B'00100111'
  	MOVWF CCPR1L	
DONGU	
  	BTFSC PORTD,0	
  	CALL CCP_ARTIR
  	BTFSC PORTD,1
  	CALL CCP_AZALT
  	GOTO DONGU
CCP_ARTIR
  	BANKSEL CCPR1L
  	MOVLW D'5'
  	ADDWF CCPR1L,1
  	CALL GECIKME
  	RETURN

CCP_AZALT
  	BANKSEL CCPR1L
  	MOVLW D'5'
  	SUBWF CCPR1L,1
  	CALL GECIKME
  	RETURN
GECIKME
  	MOVLW 	0XFF
  	MOVWF 	SAYAC1
DONGU1
  	MOVLW 	0XFF
  	MOVWF 	SAYAC2
DONGU2
	MOVLW	0XFF
	MOVWF	SAYAC3
DONGU3
  	DECFSZ 	SAYAC3,1
  	GOTO 	DONGU3
  	DECFSZ 	SAYAC2,1
  	GOTO 	DONGU2
	DECFSZ	SAYAC1,1
	GOTO	DONGU1
	RETURN
END

  
   
#INCLUDE<P16F877.INC>
SAYI	EQU		0X21
BOLUM	EQU		0X22
BOLEN	EQU		0X23
	ORG		0X00
	GOTO	ANA_PROGRAM
	
EEPROM_ADRES
	BANKSEL 	EEADR
	MOVWF		EEADR		
	BANKSEL 	0x00
	RETURN

EEPROM_OKU
	BANKSEL		EECON1			
	BSF			EECON1,RD
	BANKSEL		EEDATA		
	MOVF		EEDATA,W		
	BANKSEL		0X00
	RETURN

EEPROM_YAZ
	BANKSEL		EEDATA
	MOVWF		EEDATA

	BANKSEL		EECON1
	BSF			EECON1,WREN	

	BCF			INTCON,GIE
	MOVLW		0X55	
	MOVWF		EECON2	
	MOVLW		0XAA	
	MOVWF		EECON2	

	BSF			EECON1,WR
	BSF			INTCON,GIE

	BTFSC		EECON1,WR	
	GOTO		$-1	
		
	BCF			EECON1,WREN		
	BANKSEL		0X00			
	RETURN

ANA_PROGRAM
	MOVLW	D'122'
	MOVWF	SAYI
	MOVLW	0X00
	CALL	EEPROM_ADRES
	MOVF	SAYI,W
	CALL	EEPROM_YAZ
	
	MOVLW	D'5'
	MOVWF	BOLEN
	MOVLW	0X01
	CALL	EEPROM_ADRES
	MOVF	BOLEN,W
	CALL	EEPROM_YAZ

BOLME
	MOVF	BOLEN,W
	SUBWF	SAYI,W
	BTFSS	STATUS,C
	GOTO	YAZDIR
	INCF	BOLUM,F
	MOVF	BOLEN,W
	SUBWF	SAYI,F
	GOTO	BOLME
YAZDIR
	MOVLW	0X02
	CALL	EEPROM_ADRES
	MOVF	SAYI,W
	CALL	EEPROM_YAZ
	MOVLW	0X03
	CALL	EEPROM_ADRES
	MOVF	BOLUM,W
	CALL	EEPROM_YAZ

END

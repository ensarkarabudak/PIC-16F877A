#INCLUDE <P16F877.INC>
ADRES_SAYAC		EQU		0X21
SAYAC_GECIK1	EQU		0X22
SAYAC_GECIK2	EQU		0X23
GELEN_DATA		EQU		0X24
LCD_DATA		EQU		0X25
ORG		0X00
GOTO	ANA_PROGRAM

EEPROM_ADRES
	BANKSEL 	EEADR
	MOVWF		EEADR		
	BANKSEL 	0x00
	RETURN

EEPROM_OKU
	BANKSEL		EECON1			
	BSF			EECON1,RD
	BANKSEL		EEDATA		
	MOVF		EEDATA,W		
	BANKSEL		0X00
	RETURN

EEPROM_YAZ
	BANKSEL		EEADR
	MOVWF		EEDATA

	BANKSEL		EECON1
	BSF			EECON1,WREN	

	BCF			INTCON,GIE
	MOVLW		0X55	
	MOVWF		EECON2	
	MOVLW		0XAA	
	MOVWF		EECON2	

	BSF			EECON1,WR
	BSF			INTCON,GIE

	BTFSC		EECON1,WR	
	GOTO		$-1	
		
	BCF			EECON1,WREN		
	BANKSEL		0X00			
	RETURN

YAZDIR
	MOVF		ADRES_SAYAC,W
	CALL		EEPROM_ADRES
	MOVF		ADRES_SAYAC,W
	CALL		SATIR1
	XORLW		0X00
	BTFSC		STATUS,Z
	RETURN
	CALL		EEPROM_YAZ
	INCF		ADRES_SAYAC,1
	GOTO		YAZDIR
ILK_SATIR
	MOVF		ADRES_SAYAC,W
	CALL		EEPROM_ADRES
	CALL		EEPROM_OKU
	BTFSC		ADRES_SAYAC,4
	GOTO		IKINCI_SATIR
	CALL		VERI_YAZ
	INCF		ADRES_SAYAC,1
	GOTO		ILK_SATIR
IKINCI_SATIR
	CALL		LCD_2SATIR
MESAJ
	MOVF		ADRES_SAYAC,W
	CALL		EEPROM_ADRES
	CALL		EEPROM_OKU
	BTFSC		ADRES_SAYAC,5
	GOTO		ENDMESAJ
	CALL		VERI_YAZ
	INCF		ADRES_SAYAC,1
	GOTO		MESAJ
ENDMESAJ
	GOTO		ENDMESAJ	
ANA_PROGRAM
	BANKSEL	TRISB
	CLRF	TRISB
	CALL	LCD_INIT
	CALL	YAZDIR
	CLRF	ADRES_SAYAC
	CALL	ILK_SATIR
	
LCD_INIT							
	MOVLW	H'02'				
	CALL 	KOMUT_YAZ				
	MOVLW	H'06'				
	CALL 	KOMUT_YAZ			
	MOVLW	0X28				 
	CALL	KOMUT_YAZ			
	MOVLW	H'0C'				
	CALL	KOMUT_YAZ			
	RETURN
KOMUT_YAZ	
	BANKSEL	PORTB						
	MOVWF	LCD_DATA				
	SWAPF	LCD_DATA,W				
	CALL	KOMUT_GONDER		
	MOVF	LCD_DATA,W			
	CALL	KOMUT_GONDER			
	RETURN

KOMUT_GONDER
	BANKSEL	PORTB						
	ANDLW	0X0F					
	MOVWF	PORTB				
	BANKSEL	PORTB					
	BCF		PORTB,4				
	CALL	GECIKME			
	CALL	E_PULSE			
	RETURN

VERI_YAZ
	BANKSEL	PORTB
	MOVWF	LCD_DATA			 
	SWAPF	LCD_DATA,W				
	CALL	VERI_GONDER			
	MOVF	LCD_DATA,W			
	CALL	VERI_GONDER				
	RETURN

VERI_GONDER
	BANKSEL	PORTB
	ANDLW	0X0F					
	MOVWF	PORTB					
	BANKSEL	PORTB				
	BSF		PORTB,4				
	CALL	GECIKME				
	CALL	E_PULSE				
	RETURN

E_PULSE							
	BSF		PORTB,5				
	BCF		PORTB,5				
	RETURN

LCD_2SATIR							
	MOVLW	0XC0					
	CALL	KOMUT_YAZ
	RETURN

LCD_1SATIRW						
	ADDLW		0X80					
	CALL		KOMUT_YAZ				 
	RETURN

LCD_2SATIRW							
	ADDLW		0XC0					
	CALL		KOMUT_YAZ				
	RETURN
GECIKME
	MOVLW	H'20'
	MOVWF	SAYAC_GECIK1
DONGU1
	MOVLW	H'20'
	MOVWF	SAYAC_GECIK2
DONGU2
	DECFSZ	SAYAC_GECIK2,F
	GOTO	DONGU2
	DECFSZ	SAYAC_GECIK1,F
	GOTO	DONGU1
	RETURN
SATIR1
	ADDWF		PCL,F
	RETLW		'Z'
	RETLW		'I'
	RETLW		'Y'
	RETLW		'A'
	RETLW		' '
	RETLW		'O'
	RETLW		'Z'
	RETLW		'C'
	RETLW		'E'
	RETLW		'L'
	RETLW		'I'
	RETLW		'K'
	RETLW		' '
	RETLW		' '
	RETLW		' '
	RETLW		' '
	RETLW		'B'
	RETLW		'I'
	RETLW		'L'
	RETLW		'G'
	RETLW		'I'
	RETLW		'S'
	RETLW		'A'
	RETLW		'Y'
	RETLW		'A'
	RETLW		'R'
	RETLW		' '
	RETLW		'M'
	RETLW		'U'
	RETLW		'H'
	RETLW		'.'
	RETLW		'.'
	RETLW		0X00		
END

	LIST P=16F877						
;	ERRORLEVEL  -302  

	include <p16f877.inc>	 
;	__CONFIG _CP_OFF &_WDT_OFF &_PWRTE_ON &_HS_OSC &_BODEN_OFF &_LVP_OFF &_CPD_OFF &_WRT_ENABLE_OFF 
;------
DEGER	EQU	H'20'
DEGERH	EQU	H'21'
DEGERL	EQU	H'22'
DEGER3	EQU	H'23'
SAYI1	EQU	H'24'
SAYI2	EQU	H'25'
SAYI3	EQU	H'26'
SAYI4	EQU	H'27'
D1	EQU	H'28'
D2	EQU	H'29'
D3	EQU	H'2A'
D4	EQU	H'2B'
LSB	EQU	H'2C'
MSB	EQU	H'2D'
TEMP	EQU	H'2E'
BEKLEM	EQU	H'2F'
TOPLA1	EQU	H'34'
TOPLA2	EQU	H'35'
TOPLA3	EQU	H'36'
;---------
	ORG	00H 
	GOTO	START
;-------------
START
	CLRF	PORTA
	CLRF	PORTB
	CLRF	PORTC
	CLRF	PORTD
	CLRF	DEGER
	CLRF	DEGERH
	CLRF	DEGERL
	CLRF	DEGER3
	CLRF	SAYI1
	CLRF	SAYI2
	CLRF	SAYI3
	CLRF	SAYI4
	CLRF	D1	
	CLRF	D2	
	CLRF	D3	
	CLRF	D4
	CLRF	LSB
	CLRF	MSB
	CLRF	TEMP
	CLRF	BEKLEM
	MOVLW	B'01000001' ;A/D çevirimi açýktýr.iþlem yapýlabilir.Fosc/16
	MOVWF	ADCON0
	BSF     STATUS,RP0
	MOVLW	B'11111111'
	MOVWF	TRISA^80H      
	CLRF	TRISB^80H       
	CLRF	TRISC^80H
	CLRF	TRISD^80H
	CLRF	TRISE^80H			
	MOVLW	B'10001111'
	MOVWF	ADCON1^80	
	MOVLW	B'10000111'	;tmr0 için prescaler=256
	MOVWF	OPTION_REG
	BCF     STATUS,RP0     
	CALL	TEMIZLE ;temizleye dallan
	GOTO	GOSTER_LCD
;------------------------------
ADC
	MOVLW	.250
	MOVWF	TEMP
ADBEKLE
	DECFSZ	TEMP,F
	GOTO	ADBEKLE
	MOVLW	.250
	MOVWF	TEMP
ADBEK2
	DECFSZ	TEMP,F
	GOTO	ADBEK2	
	BSF	ADCON0,GO	;Start A/D conversion
TARA
	BTFSC	ADCON0,GO
	GOTO	TARA

	BSF	STATUS,RP0
	MOVF	ADRESL,W
	BCF	STATUS,RP0
	MOVWF	DEGERL
	MOVF	ADRESH,W
	MOVWF	DEGERH
	RETURN
;-----------------------
BEKLE
	MOVLW	.10		 	
	MOVWF	MSB
D11	
	MOVLW	.150
	MOVWF	LSB
D22
	DECFSZ	LSB,F
	GOTO	D22
	DECFSZ	MSB,F
	GOTO	D11
	RETURN
;-----------------------
HESAP
	MOVLW	.0
	MOVWF	SAYI1
	MOVWF	SAYI2
	MOVWF	SAYI3
	MOVWF	SAYI4
HES
	MOVLW	.100
	SUBWF	DEGER,W
	BTFSS	STATUS,C
	GOTO	HES1
	MOVLW	.100
	SUBWF	DEGER,F
	INCF	SAYI2,F
	GOTO	HES	
HES1
	MOVLW	.10
	SUBWF	DEGER,W
	BTFSS	STATUS,C
	GOTO	HES2
	MOVLW	.10
	SUBWF	DEGER,F
	INCF	SAYI3,F
	GOTO	HES1
HES2
	MOVLW	.1
	SUBWF	DEGER,W
	BTFSS	STATUS,C
	GOTO	HESSON
	MOVLW	.1
	SUBWF	DEGER,F
	INCF	SAYI4,F
	GOTO	HES2		
HESSON
	RETURN
;-----------------------------------------------------------------
ANA	
	CALL	ADC
	MOVF	DEGERL,W
	MOVWF	DEGER
	CALL	HESAP
	CALL	HESAP2
	MOVF	SAYI1,W
	SUBWF	D1,W
	BTFSS	STATUS,Z
	GOTO	GOSTER_LCD
	MOVF	SAYI2,W
	SUBWF	D2,W
	BTFSS	STATUS,Z
	GOTO	GOSTER_LCD
	MOVF	SAYI3,W
	SUBWF	D3,W
	BTFSS	STATUS,Z
	GOTO	GOSTER_LCD
	MOVF	SAYI4,W
	SUBWF	D4,W
	BTFSS	STATUS,Z
	GOTO	GOSTER_LCD
	GOTO	ANA
;---------------------------
GOSTER_LCD
	MOVF	SAYI1,W
	MOVWF	D1
	MOVF	SAYI2,W
	MOVWF	D2
	MOVF	SAYI3,W
	MOVWF	D3
	MOVF	SAYI4,W
	MOVWF	D4
	CALL	TEMIZLE
	MOVF	D1,W
	ADDLW	H'30'
	CALL	VERIYAZ
	MOVF	D2,W
	ADDLW	H'30'
	CALL	VERIYAZ
	MOVF	D3,W
	ADDLW	H'30'
	CALL	VERIYAZ
	MOVF	D4,W
	ADDLW	H'30'
	CALL	VERIYAZ
	GOTO	ANA
;---------------------------------------------------
HESAP2
	MOVLW	.0
	SUBWF	DEGERH,W
	BTFSC	STATUS,Z
	RETURN	
	BTFSC	DEGERH,0
	GOTO	YAZ256
DEVAM
	BTFSC	DEGERH,1
	GOTO	YAZ512
	RETURN
SONUC
	MOVLW	.10
	SUBWF	SAYI4,W
	BTFSC	STATUS,C
	CALL	BUYUK
	MOVLW	.10
	SUBWF	SAYI3,W
	BTFSC	STATUS,C
	CALL	BUYUK1
	MOVLW	.10
	SUBWF	SAYI2,W
	BTFSC	STATUS,C
	CALL	BUYUK2
	RETURN
BUYUK
	MOVWF	SAYI4	
	INCF	SAYI3,F
	RETURN
BUYUK1
	MOVWF	SAYI3	
	INCF	SAYI2,F
	RETURN
BUYUK2
	MOVWF	SAYI2	
	INCF	SAYI1,F
	RETURN
YAZ256
	MOVLW	.2
	ADDWF	SAYI2,F
	MOVLW	.5
	ADDWF	SAYI3,F
	MOVLW	.6
	ADDWF	SAYI4,F
	CALL	SONUC
	GOTO	DEVAM
YAZ512
	MOVLW	.5
	ADDWF	SAYI2,F
	MOVLW	.1
	ADDWF	SAYI3,F
	MOVLW	.2
	ADDWF	SAYI4,F
	CALL	SONUC
	RETURN
;-------------------------------------------------------------------
SATIR2
	MOVLW	H'C0'
	CALL	KOMUTYAZ
	RETURN
SATIR1
	MOVLW	H'80'
	CALL	KOMUTYAZ
	RETURN
VERIYAZ
	BSF	PORTC,1
	MOVWF	PORTB
	BCF	PORTC,0
	CALL	BEKLE
	BSF	PORTC,0
	RETURN
TEMIZLE
	;MOVLW	H'0C'
	;CALL	KOMUTYAZ
	;MOVLW	H'01'
	;CALL	KOMUTYAZ
	;MOVLW	H'38'
	;CALL	KOMUTYAZ
	;MOVLW	H'0C'
	;CALL	KOMUTYAZ
	RETURN
KOMUTYAZ
	BCF	PORTC,1
	MOVWF	PORTB
	BCF	PORTC,0
	CALL	BEKLE
	BSF	PORTC,0
	RETURN
;------------------------------------------------------------------
	END

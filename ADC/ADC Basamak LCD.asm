#INCLUDE <P16F877.INC>
ADC_DATA		EQU		0X21
ADC_SAYAC1		EQU		0X22
ADC_SAYAC2		EQU		0X23
YBOLUM			EQU		0X24
OBOLUM			EQU		0X25
YUZLER			EQU		0X26
ONLAR			EQU		0X27
BIRLER			EQU		0X28
SAYAC_GECIK1	EQU		0X29	
SAYAC_GECIK2 	EQU		0X30
LCD_DATA		EQU		0X31
USART_DATA		EQU		0X32
	ORG 	0X00

ANA_PROGRAM
	BANKSEL	TRISA
	MOVLW	0XFF
	MOVWF	TRISA
	CLRF	TRISB
	BSF		TRISC,7
	BCF		TRISC,6
	BCF		TRISC,0
	BCF		TRISC,1
	CALL	ADC_INIT
	CALL	LCD_INIT
	CALL	RS232_INIT
MAIN
	CLRF	BIRLER
	CLRF	ONLAR
	CLRF	YUZLER
	CLRF	YBOLUM
	CLRF	OBOLUM
	CALL	ADC_OKU
	BCF		STATUS,C
	RLF		ADC_DATA,1

	CALL	YUZLER_KONT	
	MOVLW	0X00
	CALL	LCD_1SATIRW	
	MOVF	BIRLER,0
	ADDLW	D'48'
	CALL	VERI_YAZ
	MOVF	ONLAR,0
	ADDLW	D'48'
	CALL	VERI_YAZ
	MOVF	YUZLER,0
	ADDLW	D'48'
	CALL	VERI_YAZ

	MOVF	BIRLER,0
	ADDLW	D'48'
	MOVWF	USART_DATA
	CALL	RS232_VERÝGONDER
	MOVF	ONLAR,0
	ADDLW	D'48'
	MOVWF	USART_DATA
	CALL	RS232_VERÝGONDER
	MOVF	YUZLER,0
	ADDLW	D'48'
	MOVWF	USART_DATA
	CALL	RS232_VERÝGONDER
	GOTO	MAIN

ADC_INIT
	BANKSEL	ADCON1
	MOVLW	B'10000000'
	MOVWF	ADCON1

	BANKSEL	ADCON0
	MOVLW	B'10000001'
	MOVWF	ADCON0
	RETURN

ADC_OKU
	BANKSEL	ADCON0
	BSF		ADCON0,2
WAIT
	BTFSC 	ADCON0,2
	GOTO 	WAIT

	MOVLW	0X06
	MOVWF	ADC_SAYAC1
H_OKU
	BCF		STATUS,C
	RLF		ADRESH,1
	DECFSZ	ADC_SAYAC1
	GOTO	H_OKU

	MOVF	ADRESH,W
	MOVWF	ADC_DATA

	BANKSEL	ADRESL
	MOVLW	0X02
	MOVWF	ADC_SAYAC2
L_OKU
	BCF		STATUS,C
	RRF		ADRESL,1
	DECFSZ	ADC_SAYAC2	
	GOTO	L_OKU

	MOVF	ADRESL,W
	BANKSEL	ADC_DATA
	ADDWF	ADC_DATA,1
	RETURN

LCD_INIT								
	MOVLW	H'02'				
	CALL 	KOMUT_YAZ				
	MOVLW	H'06'				
	CALL 	KOMUT_YAZ			
	MOVLW	0X28				 
	CALL	KOMUT_YAZ			
	MOVLW	H'0C'				
	CALL	KOMUT_YAZ			
	RETURN

KOMUT_YAZ							
	MOVWF	LCD_DATA				
	SWAPF	LCD_DATA,W				
	CALL	KOMUT_GONDER		
	MOVF	LCD_DATA,W			
	CALL	KOMUT_GONDER			
	RETURN

KOMUT_GONDER						
	ANDLW	0X0F					
	MOVWF	PORTB				
	BANKSEL	PORTB					
	BCF		PORTB,4				
	CALL	GECIKME			
	CALL	E_PULSE			
	RETURN

VERI_YAZ
	MOVWF	LCD_DATA			 
	SWAPF	LCD_DATA,W				
	CALL	VERI_GONDER			
	MOVF	LCD_DATA,W			
	CALL	VERI_GONDER				
	RETURN

VERI_GONDER
	ANDLW	0X0F					
	MOVWF	PORTB					
	BANKSEL	PORTB				
	BSF		PORTB,4				
	CALL	GECIKME				
	CALL	E_PULSE				
	RETURN

E_PULSE							
	BSF		PORTB,5				
	BCF		PORTB,5				
	RETURN

LCD_1SATIRW						
	ADDLW	0X80				
	CALL	KOMUT_YAZ			
	RETURN

RS232_INIT
	BANKSEL	INTCON
	BSF		INTCON,6
	BCF		INTCON,7
	
	MOVLW	B'10010000'
	MOVWF	RCSTA

	BANKSEL	TXSTA
	MOVLW	B'00100100'
	MOVWF	TXSTA
	MOVLW	0X33
	MOVWF	SPBRG
	BSF		PIE1,RCIE
	BSF		PIE1,TXIE	
	RETURN

RS232_VERÝGONDER
	BANKSEL	PIR1
	BTFSS	PIR1,TXIF
	GOTO	$-1
	BCF		PIR1,TXIF
	MOVF	USART_DATA,W
	MOVWF	TXREG
	RETURN

YUZLER_KONT
	MOVLW	0X0A
	SUBWF	ADC_DATA,W
	BTFSS	STATUS,C
	GOTO	ONLAR_KONT
	INCF	YBOLUM,F
	MOVLW	0X0A
	SUBWF	ADC_DATA,F
	GOTO	YUZLER_KONT
ONLAR_KONT
	MOVF	ADC_DATA,W
	MOVWF	YUZLER
	MOVLW	0X0A
	SUBWF	YBOLUM,W
	BTFSS	STATUS,C
	GOTO	BIRLER_KONT
	INCF	OBOLUM,F
	MOVLW	0X0A
	SUBWF	YBOLUM,F
	GOTO	ONLAR_KONT
BIRLER_KONT
	MOVF	YBOLUM,W
	MOVWF	ONLAR
	MOVF	OBOLUM,W
	MOVWF	BIRLER
	RETURN

GECIKME
	MOVLW	H'FF'
	MOVWF	SAYAC_GECIK1
DONGU1
	MOVLW	H'FF'
	MOVWF	SAYAC_GECIK2
DONGU2
	DECFSZ	SAYAC_GECIK2,F
	GOTO	DONGU2
	DECFSZ	SAYAC_GECIK1,F
	GOTO	DONGU1
	RETURN
END

#INCLUDE<P16F877.INC>
	SAYAC1	EQU	0X21
	SAYAC2	EQU	0X22
	ORG		0X00

ANA_PROGRAM
	BANKSEL	TRISB
	CLRF	TRISB
	BSF		TRISB,7
	BANKSEL	PORTB
	CALL	RS232_INIT
DONGU
	CALL	RS232_VERÝAL
	MOVWF	PORTB
	GOTO	DONGU
	
RS232_INIT
	BANKSEL	TXSTA
	MOVLW	B'10100100'
	MOVWF	TXSTA
	BANKSEL	RCSTA
	MOVLW	B'10010000'
	MOVWF	RCSTA
	BANKSEL	INTCON
	BSF		INTCON,6
	BSF		INTCON,7
	BANKSEL	SPBRG
	MOVLW	0X19
	MOVWF	SPBRG
	BANKSEL	PIE1
	BSF		PIE1,RCIE
	BSF		PIE1,TXIE
	RETURN

RS232_VERÝAL
	BANKSEL	PIR1
	BTFSS	PIR1,RCIF
	GOTO	$-1
	BCF		PIR1,RCIF
	MOVF	RCREG,W
	RETURN

GECÝKME
	MOVLW	0XFF
	MOVWF	SAYAC1
DONGU1
	MOVLW	0XFF
	MOVWF	SAYAC2
DONGU2
	DECFSZ	SAYAC2,1
	GOTO	DONGU2
	DECFSZ	SAYAC1,1
	GOTO	DONGU1
	RETURN
END
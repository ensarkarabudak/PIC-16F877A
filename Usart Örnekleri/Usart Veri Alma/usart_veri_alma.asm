	LIST P=16F877A
	#INCLUDE <P16F877A.INC>
	DEGER EQU 0X20 
	TEMP EQU 0X21
	ORG 0X00
	GOTO MAIN
	ORG 0X04	
	GOTO KESME
MAIN
	CALL PORT_AYAR
	CALL LCD_AYAR
	CALL USART_AYAR
DON
	GOTO DON

KESME 
	BANKSEL RCREG
	MOVF RCREG,W
	CALL VERI_YAZ
	RETFIE


PORT_AYAR
	BANKSEL TRISB	
	CLRF TRISB 
	BANKSEL TRISC
	MOVLW 0XFF
	MOVWF TRISC
	BANKSEL PORTB
	CLRF PORTB
	CLRF PORTC
	RETURN

USART_AYAR
	BANKSEL SPBRG
	MOVLW B'00110011'
	MOVWF SPBRG
	
	BANKSEL TXSTA
	MOVLW B'00000100'
	MOVWF TXSTA
	
	BANKSEL RCSTA
	MOVLW B'10010000'
	MOVWF RCSTA

	BANKSEL INTCON
	BSF INTCON,GIE
	BSF INTCON,PEIE

	BANKSEL PIE1
	BSF PIE1,RCIE
	RETURN

LCD_AYAR
	MOVLW 0X02
	CALL KOMUT_YAZ
	MOVLW 0X28	
	CALL KOMUT_YAZ
	MOVLW 0X0C
	CALL KOMUT_YAZ
	MOVLW 0X80
	CALL KOMUT_YAZ
	RETURN

KOMUT_YAZ
	MOVWF TEMP
	SWAPF TEMP,W
	CALL KOMUT_GONDER
	MOVF TEMP,W
	CALL KOMUT_GONDER
	RETURN
KOMUT_GONDER
	ANDLW 0X0F
	MOVWF PORTB
	BANKSEL PORTB
	BCF PORTB,4
	BSF PORTB,5
	CALL GECIKME
	BCF PORTB,5
	RETURN

VERI_YAZ
	MOVWF TEMP
	SWAPF TEMP,W
	CALL VERI_GONDER
	MOVF TEMP,W
	CALL VERI_GONDER
	RETURN
VERI_GONDER
	ANDLW 0X0F
	MOVWF PORTB
	BANKSEL PORTB
	BSF PORTB,4
	BSF PORTB,5
	CALL GECIKME
	BCF PORTB,5
	RETURN

GECIKME
	MOVLW 0X40
	MOVWF DEGER
DNG2
	DECFSZ DEGER,F
	GOTO DNG2
	RETURN
END
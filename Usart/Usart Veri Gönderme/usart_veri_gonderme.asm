	LIST P=16F877A
	#INCLUDE <P16F877A.INC>
	DEGER EQU 0X20
	DEGER2 EQU 0X21
	ORG 0X00
	GOTO MAIN
	ORG 0X04
	GOTO KESME
MAIN
	CALL PORT_AYAR
	CALL USART_AYAR
LOOP
	GOTO LOOP

KESME
	MOVLW A'E'
	MOVWF TXREG
	CALL GECIKME
	MOVLW A'N'
	MOVWF TXREG
	CALL GECIKME
	MOVLW A'S'
	MOVWF TXREG
	CALL GECIKME
	MOVLW A'A'
	MOVWF TXREG
	CALL GECIKME
	MOVLW A'R'
	MOVWF TXREG
	CALL GECIKME
	
	BANKSEL INTCON
	BCF INTCON,GIE
	BCF INTCON,PEIE
	RETFIE


PORT_AYAR
	BANKSEL TRISC
	CLRF TRISC
	BANKSEL PORTC
	CLRF PORTC
	RETURN

USART_AYAR
	BANKSEL SPBRG
	MOVLW D'51'
	MOVWF SPBRG

	BANKSEL TXSTA
	MOVLW B'00100100'
	MOVWF TXSTA

	BANKSEL RCSTA
	MOVLW B'10000000'
	MOVWF RCSTA

	BANKSEL PIE1
	BSF PIE1,TXIE

	BANKSEL INTCON
	BSF INTCON,GIE
	BSF INTCON,PEIE
	RETURN



GECIKME
	MOVLW 0X04
	MOVWF DEGER
DNG1
	MOVLW 0XFF
	MOVWF DEGER2
DNG2
	DECFSZ DEGER2,F
	GOTO DNG2
	DECFSZ DEGER,F
	GOTO DNG1
	RETURN
END
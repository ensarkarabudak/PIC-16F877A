	list p=16F877
	include"p16F877.inc"

	SAYAC0 EQU 0X20
	SAYAC1 EQU 0X21
	VERÝ EQU 0X22
	ORG 0X00
	
ANA_PROGRAM
	BANKSEL TRISB
	CLRF TRISB
	CLRF TRISC

	BANKSEL TRISD
	MOVLW h'FF'
    MOVWF TRISD

	BANKSEL PORTB
	CLRF PORTD
	BANKSEL PORTC
	CLRF PORTC

	MOVLW h'02'
	CALL KOMUT_YAZ

	MOVLW h'02'
	CALL KOMUT_YAZ

	MOVLW h'00'
	CALL KOMUT_YAZ

	MOVLW h'00'
	CALL KOMUT_YAZ

	MOVLW h'0E'
	CALL KOMUT_YAZ

	MOVLW h'00'
	CALL KOMUT_YAZ

	MOVLW h'06'
	CALL KOMUT_YAZ

	
	MOVLW A'S'
	CALL VERÝ_YAZ

	MOVLW A'I'
	CALL VERÝ_YAZ

	MOVLW A'F'
	CALL VERÝ_YAZ

	MOVLW	A'R'
	CALL	VERÝ_YAZ
	
	MOVLW	A'E'
	CALL	VERÝ_YAZ
    MOVLW A' '
	CALL VERÝ_YAZ

	MOVLW A'G'
	CALL VERÝ_YAZ
	MOVLW A'I'
	CALL VERÝ_YAZ

	MOVLW A'R'
	CALL VERÝ_YAZ
    MOVLW A'='
	CALL VERÝ_YAZ

	banksel PORTC
	MOVLW h'01'
	MOVWF PORTC
DÖN1	
	BANKSEL PORTD
	BTFSS PORTD,1
	GOTO DÖN1
	CALL VERÝ_YAZ

	CALL BEKLE
	CALL BEKLE

	banksel PORTC
	MOVLW h'04'
	MOVWF PORTC
DÖN2	
	BANKSEL PORTD
	BTFSS PORTD,0
	GOTO DÖN2

	CALL VERÝ_YAZ
	CALL BEKLE
	CALL BEKLE
	banksel PORTC
	MOVLW h'02'
	MOVWF PORTC
DÖN3	
	BANKSEL PORTD
	BTFSS PORTD,0
	GOTO DÖN3

 
	CALL VERÝ_YAZ
	CALL BEKLE
	CALL BEKLE
	banksel PORTC
	MOVLW h'02'
	MOVWF PORTC
DÖN4	
	BANKSEL PORTD
	BTFSS PORTD,3
	GOTO DÖN4
	CALL VERÝ_YAZ
	CALL BEKLE
	CALL BEKLE
	banksel PORTC

	MOVLW h'80'
	MOVWF PORTC
	
	CALL BEKLE
	CALL BEKLE	
	CALL BEKLE	
	CALL BEKLE
	CALL BEKLE
	CALL BEKLE
	CALL BEKLE
	CALL BEKLE
	CALL BEKLE
	CALL BEKLE
	CALL BEKLE
	CALL BEKLE
	CALL BEKLE	
	CALL BEKLE	
	CALL BEKLE
	CALL BEKLE
	CALL BEKLE
	CALL BEKLE
	CALL BEKLE
	CALL BEKLE
	CALL BEKLE
	CALL BEKLE
	CALL BEKLE
	CALL BEKLE	
	CALL BEKLE	
	CALL BEKLE
	CALL BEKLE
	CALL BEKLE
	CALL BEKLE
	CALL BEKLE
	CALL BEKLE
	CALL BEKLE
	CALL BEKLE
	
	banksel PORTC
	clrf PORTC


	MOVLW h'02'
	CALL KOMUT_YAZ

	MOVLW h'02'
	CALL KOMUT_YAZ

	MOVLW h'00'
	CALL KOMUT_YAZ

	MOVLW h'00'
	CALL KOMUT_YAZ

	MOVLW h'0E'
	CALL KOMUT_YAZ

	MOVLW h'00'
	CALL KOMUT_YAZ

	MOVLW h'06'
	CALL KOMUT_YAZ

	MOVLW A'H'
	CALL VERÝ_YAZ

	MOVLW A'O'
	CALL VERÝ_YAZ

	MOVLW A'S'
	CALL VERÝ_YAZ

	MOVLW	A'G'
	CALL	VERÝ_YAZ
	
	MOVLW	A'E'
	CALL	VERÝ_YAZ
   	MOVLW A'L'
	CALL VERÝ_YAZ

	MOVLW A'D'
	CALL VERÝ_YAZ
	MOVLW A'I'
	CALL VERÝ_YAZ

	MOVLW A'N'
	CALL VERÝ_YAZ
    MOVLW A'I'
	CALL VERÝ_YAZ
	MOVLW A'Z'
	CALL VERÝ_YAZ
    

SONSUZ 
	GOTO SONSUZ
	
KOMUT_YAZ
	MOVWF VERÝ
	BSF VERÝ,5
	BCF VERÝ,4
	MOVF VERÝ,W
	MOVWF PORTB
	CALL BEKLE
	CALL DÝSABLE
	CALL BEKLE
	RETURN

VERÝ_YAZ
	MOVWF VERÝ
	SWAPF VERÝ,W
	CALL GÖNDER
	MOVF VERÝ,W
	CALL GÖNDER
	RETURN

GÖNDER
	BANKSEL PORTB
	MOVWF PORTB
	BSF PORTB,5
	BSF PORTB,4
	CALL BEKLE
	CALL DÝSABLE
	CALL BEKLE
	RETURN


DÝSABLE
	BANKSEL PORTB
	BCF PORTB,5
	BCF PORTB,4
	RETURN

BEKLE
	MOVLW h'0F'
	MOVWF SAYAC0
DÖNGU
	MOVLW h'FF'
	MOVWF SAYAC1
DÖN
	DECFSZ SAYAC1,1
	GOTO DÖN
	DECFSZ SAYAC0,1
	GOTO DÖNGU
	RETURN

END
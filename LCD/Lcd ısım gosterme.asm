LIST P=16F877A
#INCLUDE 	<P16F877A.INC>
TEMPLCD		EQU		H'33'
COUNT		EQU		H'34'
COUNT1		EQU		H'35'
COUNTA		EQU		H'36'
COUNTB		EQU		H'37'

LCD_PORT	EQU		PORTB
LCD_TRIS	EQU		TRISB

LCD_RS		EQU		4
LCD_E		EQU		5
	
			ORG		0x00

			BCF		STATUS,6
			BSF		STATUS,5
			CLRF	LCD_TRIS
			BCF		STATUS,5

			CALL	DELAY100
			CALL	LCD_UNIT
			
			MOVLW	0x01
			CALL	LCD_CMD

			MOVLW	0x00
			ADDLW	0x80
			CALL  	LCD_CMD

			
			CLRF	COUNT
MESSAGE
			MOVF	COUNT,W
			CALL	SATIR1
			XORLW	0x00
			BTFSC	STATUS,Z
			GOTO	NEXTMESSAGE
			CALL	LCD_CHAR
			INCF	COUNT,F
			GOTO	MESSAGE

NEXTMESSAGE
			CALL	LCD_LINE2
			MOVLW	0x05
			CALL	LCD_LINE2W
			CLRF	COUNT

MESSAGE2
			MOVF	COUNT,W
			CALL	SATIR2
			XORLW	0x00
			BTFSC	STATUS,Z
			GOTO	ENDMESSAGE
			CALL	LCD_CHAR
			INCF	COUNT,F
			GOTO	MESSAGE2
			
ENDMESSAGE

STOP
			GOTO	STOP

LCD_UNIT
			CALL	DELAY100
			CALL	DELAY100

			MOVLW	0X03
			MOVWF	LCD_PORT
			BSF		LCD_PORT,LCD_E ; >
			BCF		LCD_PORT,LCD_E ; >CALL	PULSE_E
			CALL	DELAY50
			
			BSF		LCD_PORT,LCD_E ; >
			BCF		LCD_PORT,LCD_E ; >CALL	PULSE_E	
			CALL	D1
			CALL	D1

			BSF		LCD_PORT,LCD_E ; >
			BCF		LCD_PORT,LCD_E ; >CALL	PULSE_E
			CALL	D1
			CALL	D1

			MOVLW	0x02
			MOVWF	LCD_PORT
			BSF		LCD_PORT,LCD_E ; >
			BCF		LCD_PORT,LCD_E ; >CALL	PULSE_E
			CALL	DELAY50

			BSF		LCD_PORT,LCD_E ; >
			BCF		LCD_PORT,LCD_E ; >CALL	PULSE_E
			CALL	D1
			CALL	D1 

			BSF		LCD_PORT,LCD_E ; >
			BCF		LCD_PORT,LCD_E ; >CALL	PULSE_E
			CALL	D1
			CALL	D1 

			MOVLW	0x01
			MOVWF	LCD_PORT
			BSF		LCD_PORT,LCD_E ; >
			BCF		LCD_PORT,LCD_E ; >CALL	PULSE_E
			CALL	D1
			CALL	D1
			BSF		LCD_PORT,LCD_E ; >
			BCF		LCD_PORT,LCD_E ; >CALL	PULSE_E
			CALL	D1
			CALL	D1 

			BSF		LCD_PORT,LCD_E ; >
			BCF		LCD_PORT,LCD_E ; >CALL	PULSE_E
			CALL	D1
			CALL	D1 

			MOVLW	0x00
			MOVWF	LCD_PORT
			BSF		LCD_PORT,LCD_E ; >
			BCF		LCD_PORT,LCD_E ; >CALL	PULSE_E
			CALL	D1
			CALL	D1

			BSF		LCD_PORT,LCD_E ; >
			BCF		LCD_PORT,LCD_E ; >CALL	PULSE_E
			CALL	D1
			CALL	D1 

			BSF		LCD_PORT,LCD_E ; >
			BCF		LCD_PORT,LCD_E ; >CALL	PULSE_E
			CALL	D1
			CALL	D1 

			MOVLW	0x28
			CALL	LCD_CMD
			MOVLW	0x08
			CALL	LCD_CMD
			MOVLW	0x01
			CALL	LCD_CMD

			MOVLW	0x06
			CALL	LCD_CMD
			MOVLW	0x0C
			CALL	LCD_CMD
		
			RETURN
LCD_CMD
		
			MOVWF	TEMPLCD
			SWAPF	TEMPLCD,W
			ANDLW	0x0F
			MOVWF	LCD_PORT
			BCF		LCD_PORT,LCD_RS
			CALL	PULSE_E

			MOVF	TEMPLCD,W
			ANDLW	0x0F
			MOVWF	LCD_PORT
			BCF		LCD_PORT,LCD_RS

			CALL	PULSE_E
			CALL	DELAY5
			RETURN

LCD_CHARD	
			ANDLW	0x30

LCD_CHAR
			MOVWF	TEMPLCD
			SWAPF	TEMPLCD,W
			ANDLW	0x0F
			MOVWF	LCD_PORT
			BSF		LCD_PORT,LCD_RS
			CALL	PULSE_E

			MOVF	TEMPLCD,W
			ANDLW	0x0F
			MOVWF	LCD_PORT
			BSF		LCD_PORT,LCD_RS

			CALL	PULSE_E
			CALL	DELAY5
			RETURN

LCD_LINE1
			MOVLW	0x80
			CALL	LCD_CMD
			RETURN
LCD_LINE2
			MOVLW	0xC0
			CALL	LCD_CMD
			RETURN
LCD_LINE1W
			ADDLW	0x80
			CALL	LCD_CMD
			RETURN
LCD_LINE2W
			ADDLW	0xC0
			CALL	LCD_CMD
			RETURN

LCD_CURON
			MOVLW	0x0D
			CALL	LCD_CMD
			RETURN
LCD_CUROFF
			MOVLW	0x0C
			CALL	LCD_CMD
			RETURN 
LCD_CLR 
 		 	MOVLW	0x01
			CALL	LCD_CMD
			RETURN
DELAY255
			MOVLW	0XFF
			GOTO	D0
DELAY100
			MOVLW	D'100'
			GOTO	D0
DELAY50
			MOVLW	D'50'
			GOTO	D0
DELAY20
			MOVLW	D'20'
			GOTO	D0
DELAY5		MOVLW	0X05
D0			MOVWF	COUNT1
D1			MOVLW	0xC7
			MOVWF	COUNTA
			MOVLW	0x01
			MOVWF	COUNTB
DELAY_0
			DECFSZ	COUNTA,F
			GOTO	$+2
			DECFSZ	COUNTB,F
			GOTO	DELAY_0

			DECFSZ	COUNT1,F
			GOTO	D1
			RETURN
PULSE_E
			BSF		LCD_PORT,LCD_E
			BCF		LCD_PORT,LCD_E
			RETURN
SATIR1
			ADDWF	PCL, F
			RETLW	'E'
			RETLW	'N'
			RETLW	'S'
			RETLW	'A'
			RETLW	'R'
			RETLW	0x00

SATIR2
			ADDWF	PCL, F
			RETLW	'K'
			RETLW	'A'
			RETLW	'R'
			RETLW	'A'
			RETLW	'B'
			RETLW	'U'
			RETLW	'D'
			RETLW	'A'
			RETLW	'K'
			RETLW	0x00






END




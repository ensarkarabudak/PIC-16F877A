	INCLUDE "P16F877.INC"

	ORG 0X00
	GOTO BASLA
	ORG 0X04
	GOTO KESME
	SK EQU 0X21
	GOSTER EQU 0X22
	SAY1 EQU 0X33
	SAY2 EQU 0X34
	VERI EQU 0X35


BASLA:
	BANKSEL TRISB
	MOVLW 0XF0
	MOVWF TRISB
	CLRF TRISC
	
	MOVLW B'10001000'
	MOVWF INTCON
	BANKSEL PORTC
	CLRF PORTC
	CLRF PORTB
	MOVLW 0X01
	MOVWF SK

	MOVLW h'02'
	CALL KOMUT_YAZ


	MOVLW h'02'
	CALL KOMUT_YAZ

	MOVLW h'00'
	CALL KOMUT_YAZ

	MOVLW h'00'
	CALL KOMUT_YAZ


	MOVLW h'0E'
	CALL KOMUT_YAZ


	MOVLW h'00'
	CALL KOMUT_YAZ


	MOVLW h'06'
	CALL KOMUT_YAZ








SUTUN:
	MOVFW SK
	MOVWF PORTB	
	RLF SK,F
	BTFSC SK,0X04
	CALL BASASAR
	
GOTO SUTUN	

 
KESME:
	BTFSS INTCON,0X00
	RETFIE 
	BCF INTCON,0X00

	
	MOVLW h'03'
	CALL HARF_YAZ

	MOVFW PORTB
	CALL HARF_YAZ
	CLRF PORTB
	
	CLRF PORTC
	
 	RETFIE

BASASAR: 
	MOVLW 0X01
	MOVWF SK
RETURN




KOMUT_YAZ
	MOVWF VERI
	BSF VERI,5
	BCF VERI,4
	MOVF VERI,W
	MOVWF PORTC
	CALL BEKLE
	CALL DISABLE
	CALL BEKLE
RETURN


HARF_YAZ
	MOVWF VERI
	BSF VERI,5
	BSF VERI,4
	MOVF VERI,W
	MOVWF PORTC
	CALL BEKLE
	CALL DISABLE
	CALL BEKLE
RETURN

BEKLE

	MOVLW 0XFF
	MOVWF SAY1
D1
	MOVLW 0XFF
	MOVWF SAY2
D2
	DECFSZ SAY2,F
	GOTO D2
	DECFSZ SAY1,F
	GOTO D1
	RETURN

DISABLE
	BANKSEL PORTC
	BCF PORTC,5
	BCF PORTC,4
	RETURN
	

END

	

	


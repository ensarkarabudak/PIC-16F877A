LCD_UNIT
			CALL	DELAY100
			CALL	DELAY100

			MOVLW	0X03
			MOVWF	LCD_PORT
			BSF		LCD_PORT,LCD_E ; >
			BCF		LCD_PORT,LCD_E ; >CALL	PULSE_E
			CALL	DELAY50
			
			BSF		LCD_PORT,LCD_E ; >
			BCF		LCD_PORT,LCD_E ; >CALL	PULSE_E	
			CALL	D1
			CALL	D1

			BSF		LCD_PORT,LCD_E ; >
			BCF		LCD_PORT,LCD_E ; >CALL	PULSE_E
			CALL	D1
			CALL	D1

			MOVLW	0x02
			MOVWF	LCD_PORT
			BSF		LCD_PORT,LCD_E ; >
			BCF		LCD_PORT,LCD_E ; >CALL	PULSE_E
			CALL	DELAY50

			MOVLW	0x28
			CALL	LCD_CMD
			MOVLW	0x08
			CALL	LCD_CMD
			MOVLW	0x01
			CALL	LCD_CMD

			MOVLW	0x06
			CALL	LCD_CMD
			MOVLW	0x0C
			CALL	LCD_CMD
		
			RETURN
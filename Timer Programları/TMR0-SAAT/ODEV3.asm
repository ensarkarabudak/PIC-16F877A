LIST	P=16F877A
#INCLUDE <P16F877A.INC>
__config H'3F31'
SAYAC EQU 0X25
DEGISKEN EQU 0X26
DEGISKEN2 EQU 0X27
BIR EQU 0X28
IKI EQU 0X29
ARA EQU 0X30
SAYI EQU 0X31


ORG 0X00
	GOTO MAIN

ORG 0X04
	GOTO KESME

KESME
	BTFSS INTCON,T0IF
	RETFIE
	BCF INTCON,T0IF
	DECFSZ SAYAC,F
	RETFIE
	MOVLW D'61'
	MOVWF SAYAC
	INCF ARA
	MOVLW D'10'
	SUBWF ARA,W
	BTFSS STATUS,Z
	GOTO BIRLER_BAS
	GOTO ONLAR_BAS
BIRLER_BAS
	MOVF ARA,W
	MOVWF BIR
	RETFIE
ONLAR_BAS
	MOVLW D'5'
	SUBWF IKI,W
	BTFSC STATUS,Z
	GOTO SIFIRLA
	INCF IKI
	CLRF ARA
	CLRF BIR
	RETFIE
SIFIRLA
	CLRF ARA
	CLRF BIR
	CLRF IKI
	RETFIE

MAIN
	BANKSEL ADCON1
	MOVLW H'06'
	MOVWF ADCON1

	CLRF TRISA
	CLRF TRISB

	MOVLW B'00000101' ; PS2:PS0 1/64 
	MOVWF OPTION_REG

	BANKSEL SAYAC
	CLRF BIR
	CLRF IKI
	CLRF SAYI
	MOVLW D'61'
	MOVWF SAYAC

	MOVLW B'11100100' ; GIE PIE TMR0IF
	MOVWF INTCON

SONSUZ
	MOVLW D'1'
	MOVWF PORTA
	MOVF BIR,W
	CALL TABLE
	MOVWF PORTB

	CALL SUPURME

	MOVLW D'2'
	MOVWF PORTA
	MOVF IKI,W
	CALL TABLE
	MOVWF PORTB
	
	CALL SUPURME

GOTO SONSUZ

SUPURME
	MOVLW D'250'
	MOVWF DEGISKEN
GECIK
	DECFSZ DEGISKEN,F
	GOTO GECIK
	RETURN

TABLE
	ADDWF PCL,F
	RETLW B'0111111' ;0
	RETLW B'0000110' ;1	
	RETLW B'1011011' ;2	
	RETLW B'1001111' ;3
	RETLW B'1100110' ;4
	RETLW B'1101101' ;5
	RETLW B'1111101' ;6
	RETLW B'0000111' ;7
	RETLW B'1111111' ;8
	RETLW B'1101111' ;9

END
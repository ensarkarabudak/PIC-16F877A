DEG1	EQU		0X21
SAYAC	EQU		0X25	
;SAYAC2	EQU		0X26

		ORG		0X00
		CALL	HAZIRLA	
		GOTO	LOOP
		ORG		0X04
		CALL	KESME

LOOP
		NOP
		NOP
		GOTO	LOOP

HAZIRLA
		
		BANKSEL	TRISD
		CLRF	TRISD
		
		MOVLW	B'1000001'
		MOVWF	OPTION_REG
	
		BANKSEL	TMR0
		
		BCF		INTCON,T0IF
		BSF		INTCON,T0IE
		BSF		INTCON,PEIE
		BSF		INTCON,GIE
		
		MOVLW	H'D9'
		MOVWF	TMR0

		MOVLW	0X1D
		MOVWF	SAYAC

		CLRF	PORTD
RETURN
	
KESME
		BCF		INTCON,GIE
		
		BTFSC	INTCON,T0IF
		CALL	ZAMANLAYICI_0
		
		BSF		INTCON,GIE
		
RETURN
		
	
ZAMANLAYICI_0
		
		DECFSZ	SAYAC,F
		GOTO	L1
		
;		MOVLW	0XFF
;		XORWF	PORTD,F
		INCF	PORTD,F
		MOVLW	0X1D
		MOVWF	SAYAC
L1
		BCF	INTCON,T0IF
		
		MOVLW	H'D9'
		MOVWF	TMR0
RETURN
END
	list p=16F877
 	include "p16F877.inc"
	SAYAC0 EQU 0X20
	SAYAC1 EQU 0X21
	
	ORG 0X00
	GOTO ANA_PROGRAM
	ORG	0X04
	GOTO KESME

ANA_PROGRAM
	BANKSEL TRISD
	CLRF TRISD
	BANKSEL PORTD
	CLRF PORTD
	BANKSEL T2CON
	MOVLW h'FF'
	MOVWF T2CON
	CLRF TMR2
	BANKSEL PIE1
	BSF PIE1,TMR2IE
	BANKSEL INTCON
	MOVLW h'C0'
	MOVWF INTCON
	BANKSEL PR2
	MOVLW B'01100011'
	MOVWF PR2  
	MOVLW h'FF'
	MOVWF SAYAC0


SONSUZ
	GOTO SONSUZ

KESME
 	BTFSS PIR1,TMR2IF
	RETFIE
	BCF PIR1,TMR2IF
	CALL GECÝK
	INCF PORTD
	RETFIE





GECÝK
	MOVLW h'FF'
	MOVWF SAYAC1
	DECFSZ SAYAC0,1
	RETURN
DÖN
	DECFSZ SAYAC1,1
	GOTO DÖN
	GOTO GECÝK
		
END
 
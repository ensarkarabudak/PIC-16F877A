;****************************************************
;************100 MS  ARALIKLARLA SOLA DOÐRU KAYAN IÞIK


list p= 16f877
include "p16f877.inc"

REG1 EQU 0X23
SAYAC0 EQU 0X24
SAYAC1 EQU 0x25
SAYAC2 EQU 0X26
ORG 0000
GOTO BAS 

 
BAS 
BSF STATUS,RP0
CLRF TRISB
BCF STATUS,RP0
MOVLW H'01'
MOVWF REG1
MOVWF PORTB
MOVLW D'100'
CALL GECIK
DON
RLF REG1,1
MOVF REG1,0
MOVWF PORTB
MOVLW D'100'
CALL GECIK
GOTO DON
GECIK				;working register'a atýlan deger kadar ms gecik
	MOVWF SAYAC0		;( W * 8 * 255 ) / 2 = W * 1020µsec ~= W ms @ 8Mmhz
DONGU0
	MOVLW D'8'
	MOVWF SAYAC1
DONGU1
	CLRF SAYAC2
DONGU2
	INCFSZ SAYAC2,F
	GOTO DONGU2
	DECFSZ SAYAC1,F
	GOTO DONGU1
	DECFSZ SAYAC0,F
	GOTO DONGU0
	RETURN



END




#INCLUDE <P16F877.INC>

	SAYAC	EQU		0X21
	INTX 	EQU		0X22
	ORG 	0X00
	GOTO	START
	ORG 	0X04
	GOTO 	KESME
START
	MOVLW 	B'11000000'  ;GIE AKTIF -Cevresel Kesme Aktif
	MOVWF 	INTCON
	BSF		STATUS,RP0
	MOVLW 	B'00000001'
	MOVWF 	PIE1  
	BANKSEL	TRISB
	CLRF	TRISB        
	CLRF	TRISC
	BCF		STATUS,RP0
	MOVLW   B'00010001'                       ;Timer kesmesini aktif et ve prescaler degeri 2
	MOVWF 	T1CON
	MOVLW 	D'1'
	MOVWF 	SAYAC
	
	MOVLW	0X01
	MOVWF	PORTB
	MOVLW	0X01
	MOVWF	PORTC

	MOVLW	D'250'
	MOVWF	INTX
	MOVLW	B'11010001'
	BANKSEL	OPTION_REG
	MOVWF	OPTION_REG

	BANKSEL	TMR0
	MOVLW	D'6'
	MOVWF	TMR0
	BANKSEL	INTCON
	BSF		INTCON,D'5'
	BSF		INTCON,D'7'
	MOVLW 	H'15'
	MOVWF 	TMR1H
	MOVLW 	H'A0'
	MOVWF 	TMR1L
	GOTO	DON
KESME
	BTFSS	INTCON,2
	GOTO	$+4
	DECFSZ 	INTX,1
	GOTO	TMR0_DENE
	GOTO	PORTB_YAK
	BTFSS	PIR1,0
	RETFIE
	DECFSZ	SAYAC,1
	GOTO	DENE
	GOTO	YAK
TMR0_DENE
	MOVLW	D'6'
	MOVWF	TMR0
	BCF		INTCON,2
	RETFIE
PORTB_YAK	
	BANKSEL	PORTB
	RLF		PORTB,1
	MOVLW	D'6'
	MOVWF	TMR0
	MOVLW	D'250'
	MOVWF	INTX
	BCF		INTCON,2
	RETFIE
DENE
	BANKSEL	PIR1
	BCF	  	PIR1,0
	MOVLW 	H'15'
	MOVWF 	TMR1H
	MOVLW 	H'A0'
	MOVWF 	TMR1L
	RETFIE
YAK	
	BANKSEL	PIR1
	BCF	  	PIR1,0
	RLF		PORTC,1
	MOVLW 	H'15'
	MOVWF 	TMR1H
	MOVLW 	H'A0'
	MOVWF 	TMR1L
	MOVLW	D'1'
	MOVWF	SAYAC
	RETFIE
DON
	GOTO	DON
END
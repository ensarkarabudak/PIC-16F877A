	list p=16F877
	include "p16F877.inc"

	SAYAC EQU 0x20
	SAYAC1 EQU 0x21
	
 	ORG 0
	GOTO ANA_PROGRAM
	ORG 4
	GOTO KESME	

ANA_PROGRAM
	BANKSEL TRISD 
	CLRF TRISD
	BANKSEL TRISA
	CLRF TRISA
	BANKSEL PORTA
	MOVLW h'01'
	MOVWF PORTA 
	 
	MOVLW h'00000001'
	BANKSEL T1CON 
	MOVWF T1CON  
	BCF PIR1,TMR1IF
	BANKSEL PIE1  
	BSF PIE1,TMR1IE 
	MOVLW 0x00    
	BANKSEL PORTD 
	MOVWF PORTD	 
	CLRF SAYAC 
	MOVLW 0xC0 
	MOVWF INTCON
	MOVLW h'FF'
    MOVWF SAYAC1
	
KONTROL_ET
	MOVLW D'10'
	SUBWF SAYAC,W
	BTFSS STATUS,Z
	GOTO KONTROL_ET
	CLRF SAYAC
	INCF SAYAC1
	MOVF SAYAC1,W
	ANDLW B'00001111'
	CALL LOOK_UP
	MOVWF PORTD
	GOTO KONTROL_ET
	
KESME
	INCF SAYAC
	BANKSEL PIR1
	BCF PIR1,0
	RETFIE    


LOOK_UP  
	addwf PCL,F   
    retlw 0x3F
    retlw 0x06
    retlw 0x5B
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	retlw 0x80

	END	

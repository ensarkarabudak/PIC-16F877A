#INCLUDE <P16F877.INC>

	CARPAN	EQU		0X33
	ORG		0X00
	GOTO	PROGRAM
	ORG		0X04
	GOTO 	KESME

PROGRAM

	MOVLW	D'250'	;CARPAN REGISTIRINA 250 DEGERÝNÝ EKLÝYORUZ
	MOVWF	CARPAN

	BANKSEL	TRISB	;TRISB NIN OLDUGU BANK'A GECIS YAPIYORUZ
	CLRF	TRISB	;TRISB REGISTERINI SIFIRLIYARAK CIKIS OLARAK AYARLIYORUZ
	BANKSEL	PORTB	;PORTB REGISTERININ OLDUGU BANK'A GECIK YAPIYORUZ
	MOVLW	0X01	;PORTB REGISTERINA 1 DEGERINI YUKLEMEK ICIN ONCE WREG REGISTERINA 1 DEGERINI ATIYORUZ
	MOVWF	PORTB	;WREG REGISTERINDAKI DEGERI PORTB REGISTERINA EKLIYORUZ

	MOVLW	B'11010001'	;TIMER0 KESMESI ICIN OPTION_REG KONFIGURASYON AYARLARINI YAPIYORU
	BANKSEL	OPTION_REG
	MOVWF	OPTION_REG

	BANKSEL	TMR0	;TÝMER0 KESME REGÝSTERININ OLDUÐU BANKA GEÇÝÞ
	MOVLW	D'6'	;WREG REGISTERINA 6 DEÐERÝ EKLENÝYOR  
	MOVWF	TMR0	;WREG REGISTERINA EKLENEN BU DEÐER TMR0 REGISTERINA AKTARILIYOR
	
	BSF		INTCON,D'5'	;TIMER0 SAYICI TASMA KESMESINE IZIN VERIYORUZ
	BSF		INTCON,D'7'	;TUM KESME ISLEMLERI ICIN IZIN VERIYORUZ

	GOTO	DONGU	;SONSUZ DÖNGÜYE GÝRÝYOR

KESME
	BTFSS	INTCON,5	;INTCON REGISTERININ 5.BITINI KONTROL EDEREK TRM0 REGISTERINDA TASMA OLUP OLMADIGINI KONTROL EDIYORUZ
	RETFIE				
	BTFSS	INTCON,2	;TMR0 DEGERININ 255 DEGERINE GELIP GELMEDIGININ KONTROLUNU YAPIYORUZ
	RETFIE
	DECFSZ	CARPAN,1	;CARPAN DEGERINI BIR EKSILTEREK DEGERIN SIFIR OLUP OLMADIGINI KONTROL EDIYORUZ
	GOTO	DENE		;CARPAN DEGERI SIFIR OLMADIYSA DENE ALT PROGRAMINA DALLANACAK
	GOTO	YAK			;CARPAN SIFIR OLDUYSA YAK ALT PROGRAMINA DALLANMA OLACAK

DENE	
	MOVLW	D'6'		;WREG REGISTIRINA 6 DEGERINI ATIYORUZ	
	MOVWF	TMR0		;WREG DEKI BU 6 DEGERINI TMR0'A AKTARIYORUZ
	BCF		INTCON,2	;INTCON REGISTIRININ 2.BÝTÝNÝ PASÝF YAPARAK KESMEYI TEKRARLIYORUZ
	RETFIE

YAK
	RLF		PORTB,1		;PORTB RLF KOMUTUYLA PORTB DEKI 1 DEGERI SIRA SIRA LEDLER UZERINDE KAYDIRILIYOR
	MOVLW	D'6'		;WREG REGISTIRINA 6 DEGERINI ATIYORUZ
	MOVWF	TMR0		;WREG DEKI BU 6 DEGERINI TMR0'A AKTARIYORUZ
	MOVLW	D'250'		;CARPAN REGISTIRINA 250 DEGERÝNÝ EKLÝYORUZ
	MOVWF	CARPAN		;
	RETFIE
DONGU
	GOTO	DONGU
END
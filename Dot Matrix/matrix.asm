LIST P=16F877A
#INCLUDE <P16F877A.INC>
SAYAC1 EQU 0X20
SAYAC2 EQU 0X21
SAYI EQU 0X22
ORG 0X00
GOTO MAIN


MAIN

BANKSEL TRISB
CLRF TRISB
CLRF TRISC
BANKSEL PORTB
CLRF SAYI
CLRF PORTC
CLRF PORTB

ISLEM
MOVLW B'00000001'
MOVWF PORTC

MOVLW D'0'
MOVWF SAYI
CLRW


ISLEM2
MOVF SAYI,W
SUBLW D'5'
BTFSC STATUS,Z
GOTO ISLEM
MOVF SAYI,W
CALL TABLO
MOVWF PORTB
CALL GECIKME
RLF PORTC,F
INCF SAYI,F
GOTO ISLEM2

TABLO
	ADDWF PCL,F
	RETLW B'00000000'
	RETLW B'00110110'
	RETLW B'00110110'
	RETLW B'00110110'
	RETLW B'00110110'

GECIKME
	MOVLW D'255'
	MOVWF SAYAC1
DON1
	MOVLW D'20'
	MOVWF SAYAC2
DON2
	DECFSZ SAYAC2
	GOTO DON2
	DECFSZ SAYAC1
	GOTO DON1
	RETURN


END
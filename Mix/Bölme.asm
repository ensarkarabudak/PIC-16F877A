LIST P=16f877a
#INCLUDE <P16F877A.INC>
DEG2		EQU		0X25
DEG1		EQU		0X24
SAYAC1		EQU		0X21
SAYAC2		EQU		0X22
SONUC		EQU		0X23
			
			ORG		0X00
	 	    ;CLRF	PORTB

			BSF		STATUS,5
		;	MOVLW	H'FF'
		;	MOVWF	TRISB
			MOVLW	H'00'
			MOVWF	TRISC
			MOVLW	H'00'
			MOVWF	TRISD
			BCF		STATUS,5
			CLRF DEG1
			CLRF DEG2
			CLRF	PORTC
			CLRF	PORTD

			MOVLW	0X0A
			MOVWF	SAYAC1


			MOVLW	0X04
			MOVWF	SAYAC2
			CLRF	SONUC
		
DON
			MOVF	SAYAC2,W
			SUBWF	SAYAC1,F
			BTFSS	STATUS,C
			GOTO	YAZ
			INCF	DEG1,F
			MOVF	SAYAC1,W
			MOVWF	DEG2
			GOTO	DON


	YAZ
	
			MOVF	DEG2,W
			MOVWF	PORTD

			MOVF	DEG1,W
			MOVWF	PORTC

END
LIST P=16f877a
#INCLUDE <P16F877A.INC>
DEG2		EQU		0X25
DEG1		EQU		0X24
SAYAC1		EQU		0X21
SAYAC2		EQU		0X22
SONUC		EQU		0X23
			
				ORG		0X00
				CALL	BASLA
				GOTO	LOOP
				ORG		0X04
				CALL	KESME

LOOP
		NOP
		NOP
		GOTO	LOOP

BASLA
		BCF		INTCON,T0IF
		BSF		INTCON,T0IE
		BSF		INTCON,PEIE
		BSF		INTCON,GIE

		
				BSF		STATUS,RP0

				MOVLW	0X00
				MOVWF	TRISC
				
				MOVLW	B'10000111'
				MOVWF	OPTION_REG
				
				BCF		STATUS,RP0
			
				MOVLW	0X07
				MOVWF	TMR0
				
				MOVLW	D'31'
				MOVWF	SAYAC1
				
				CLRF	PORTC
		RETURN

KESME
				BCF		INTCON,GIE
			
				BTFSC	INTCON,T0IF
				CALL	L1
				BTFSS	INTCON,T0IF
				CALL	L3
				
				BSF		INTCON,GIE
		RETURN
L1

				DECFSZ	SAYAC1,F
				GOTO	L2	
				CALL	YAK

				MOVLW	D'31'
				MOVWF	SAYAC1
				
L2
				
				BCF		INTCON,T0IF
				MOVLW	0X07
				MOVWF	TMR0
			
				
			RETURN
L3

				DECFSZ	SAYAC1,F
				GOTO	L4
				CALL	SON

				MOVLW	D'31'
				MOVWF	SAYAC1
				
L4
				
				BCF		INTCON,T0IF
				MOVLW	0X07
				MOVWF	TMR0
			
				
			RETURN
				
SON
			CLRF	PORTC
RETURN

YAK
				MOVLW	0X01
				MOVWF	PORTC
				
			RETURN	
END	
LIST P=16F877A
INCLUDE <P16F877A.INC>
SAYAC0 EQU 0X21
SAYAC1 EQU 0X22
SAYAC2 EQU 0X23
SAYAC3 EQU 0X24
ORG 0
GOTO ANA
ORG 4
GOTO KESME

ANA
	BANKSEL TRISC
	CLRF TRISB
	BANKSEL PORTA
	CLRF PORTB
	MOVLW D'31'
	MOVWF SAYAC0
	BANKSEL INTCON
	MOVLW B'11000000'
	MOVWF INTCON
	BANKSEL PIR1
	BCF PIR1,0
	BANKSEL TMR1H
	MOVLW D'56'
	MOVWF TMR1H
	MOVLW D'50'
	MOVWF TMR1L
	BANKSEL PIE1
	BSF PIE1,0
	BANKSEL T1CON
	MOVLW B'0011001'
	MOVWF T1CON
	GOTO $
KESME
	BANKSEL PIR1
	BCF PIR1,0
	DECFSZ SAYAC0,1
	RETFIE
	INCF PORTB 	
	MOVLW D'32'
	MOVWF SAYAC0
	BANKSEL TMR1H
	MOVLW D'56'
	MOVWF TMR1H
	MOVLW D'50'
	MOVWF TMR1L
	
	RETFIE








END

		LIST	P=16f877A
		INCLUDE	"P16F877A.INC"
SAYAC	EQU		20H
;b3 tmr0 SAYAC=18, (256-TMR= 217 TMR=39)
		ORG		0X0
		GOTO	ANA_PROGRAM
		ORG		0X4
KESME
		BCF		INTCON,T0IF
		DECFSZ	SAYAC,1
		GOTO	KESMEDENDON
LED
		MOVLW	.18
		MOVWF	SAYAC
		MOVLW	08H
		XORWF	PORTB		
KESMEDENDON
		BANKSEL	81H;BANK 1
		MOVLW	07H;PRESCALLER 1:256 VE TMR 0 MODU
		MOVWF	OPTION_REG;PRESCALLER 1:256 VE TMR 0 MODU
		BANKSEL	TMR0; BANK 0
		MOVLW	.39
		MOVWF	TMR0
		RETFIE
ANA_PROGRAM
		BSF		INTCON,GIE
		BSF		INTCON,	PEIE
		BSF		INTCON,T0IE
		bcf		INTCON,T0IF
		BANKSEL 81H		;OPTION REGÝN BANK1DEKÝ ADRESÝ
		CLRF	TRISB
		MOVLW	07H;PRESCALLER 1:256 VE TMR 0 MODU
		MOVWF	OPTION_REG;PRESCALLER 1:256 VE TMR 0 MODU
		BANKSEL	SAYAC;BANK 0 DAKÝ ADRES
		MOVLW	.18
		MOVWF	SAYAC
		MOVLW	.39
		MOVWF	TMR0
		CLRF	PORTB
		GOTO	$
		END
		
